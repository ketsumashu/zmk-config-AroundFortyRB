## config/west.yml
```yaml
manifest:
  remotes:
    - name: zmkfirmware
      url-base: https://github.com/zmkfirmware
    # PMW3610センサーモジュール
    - name: badjeff
      url-base: https://github.com/badjeff
    # RGB Widgetモジュール
    - name: caksoylar
      url-base: https://github.com/caksoylar
    - name: razilyis
      url-base: https://github.com/razilyis
  projects:
    - name: zmk
      remote: zmkfirmware
      revision: v0.3.0
      import: app/west.yml
    - name: zmk-rgbled-widget
      remote: caksoylar
      revision: v0.3-branch
    - name: zmk-pmw3610-driver
      remote: razilyis
      revision: Dev-v0.3_inertial-scroll
  self:
    path: config
```
